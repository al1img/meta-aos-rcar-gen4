## meta-aos-rcar-gen4-aosedge/conf/layer.conf
```bitbake
# We have a conf and classes directory, add to BBPATH
BBPATH .= ":${LAYERDIR}"

# We have a packages directory, add to BBFILES
BBFILES += "${LAYERDIR}/recipes-*/*/*.bb \
            ${LAYERDIR}/recipes-*/*/*.bbappend"

BBFILE_COLLECTIONS += "aos-rcar-gen4-aosedge"
BBFILE_PATTERN_aos-rcar-gen4-aosedge := "^${LAYERDIR}/"
BBFILE_PRIORITY_aos-rcar-gen4-aosedge = "16"

LAYERSERIES_COMPAT_aos-rcar-gen4-aosedge = "dunfell"
```
